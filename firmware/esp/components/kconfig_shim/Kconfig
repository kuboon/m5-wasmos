## firmware/esp/components/kconfig_shim/Kconfig
```kconfig
# esp_wifi_remote 0.8.5 は esp_hosted を上限なしで要求するので、依存解決のときに
# esp_hosted 3.x の manifest も評価され、そこにある if 条件の Kconfig が参照される。
# 実際に使う esp_hosted 1.4.0 にはこれらが無く「Kconfig が見つからない」で止まるので、
# 使わない値（n）として定義だけしておく。esp_hosted を 2.x 以降に上げたら消す。
menu "m5-wasmos: esp_hosted 3.x manifest shim"
    config ESP_HOSTED_HOST_USB_CHERRYUSB_MANIFEST
        bool
        default n
    config ESP_HOSTED_HOST_USB_CDC_ACM_MANIFEST
        bool
        default n
    config ESP_HOSTED_HOST_USB_RNDIS_MANIFEST
        bool
        default n
    config ESP_HOSTED_CP_TINYUSB_MANIFEST
        bool
        default n
endmenu
```

## firmware/esp/sdkconfig.defaults
```kconfig
CONFIG_IDF_TARGET="esp32p4"
# Tab5 の ESP32-P4 は初期リビジョン（ROM: esp32p4-eco2 = v1.x）。ESP-IDF 5.5 の既定は v3.1 以上で、
# そのままだとブートローダーが Illegal instruction で落ちる（M5Stack 公式デモと同じ設定にする）
CONFIG_ESP32P4_SELECTS_REV_LESS_V3=y
CONFIG_ESP32P4_REV_MIN_1=y
CONFIG_ESPTOOLPY_FLASHMODE_QIO=y
CONFIG_ESPTOOLPY_FLASHSIZE_16MB=y
CONFIG_PARTITION_TABLE_CUSTOM=y
CONFIG_PARTITION_TABLE_CUSTOM_FILENAME="partitions.csv"
CONFIG_COMPILER_OPTIMIZATION_PERF=y
CONFIG_ESP_DEFAULT_CPU_FREQ_MHZ_360=y

# PSRAM 32MB（ヒープとフレームバッファ、wasm のメモリ）
CONFIG_SPIRAM=y
CONFIG_SPIRAM_SPEED_200M=y
CONFIG_SPIRAM_XIP_FROM_PSRAM=y
CONFIG_SPIRAM_USE_MALLOC=y
CONFIG_CACHE_L2_CACHE_256KB=y
CONFIG_CACHE_L2_CACHE_LINE_128B=y

CONFIG_FREERTOS_HZ=1000
CONFIG_ESP_MAIN_TASK_STACK_SIZE=8192
CONFIG_FREERTOS_TASK_CREATE_ALLOW_EXT_MEM=y

# コンソールは USB-C（USB Serial/JTAG）。書き込みもここから
CONFIG_ESP_CONSOLE_USB_SERIAL_JTAG=y

# HTTPS（GitHub Pages / 各種 API）
CONFIG_MBEDTLS_CERTIFICATE_BUNDLE=y
CONFIG_MBEDTLS_CERTIFICATE_BUNDLE_DEFAULT_FULL=y
CONFIG_ESP_HTTP_CLIENT_ENABLE_HTTPS=y
CONFIG_MBEDTLS_EXTERNAL_MEM_ALLOC=y

# Wi-Fi: ESP32-C6 を SDIO 越しに使う（M5Stack 公式デモと同じ設定）
CONFIG_ESP_HOSTED_ENABLED=y
CONFIG_ESP_HOSTED_SDIO_HOST_INTERFACE=y
CONFIG_SLAVE_IDF_TARGET_ESP32C6=y
CONFIG_ESP_HOSTED_SDIO_4_BIT_BUS=y
CONFIG_ESP_HOSTED_SDIO_CLOCK_FREQ_KHZ=40000
CONFIG_ESP_HOSTED_SDIO_RESET_ACTIVE_LOW=y
CONFIG_ESP_HOSTED_SDIO_GPIO_RESET_SLAVE=15
CONFIG_ESP_HOSTED_SDIO_PIN_CMD=13
CONFIG_ESP_HOSTED_SDIO_PIN_CLK=12
CONFIG_ESP_HOSTED_SDIO_PIN_D0=11
CONFIG_ESP_HOSTED_SDIO_PIN_D1=10
CONFIG_ESP_HOSTED_SDIO_PIN_D2=9
CONFIG_ESP_HOSTED_SDIO_PIN_D3=8
CONFIG_ESP_WIFI_REMOTE_LIBRARY_HOSTED=y

CONFIG_SPIFFS_MAX_PARTITIONS=2
```
